/dts-v1/;
/plugin/;

/ {
	fragment@0 {
		target = <&i2c1>;

		__overlay__ {

			#address-cells = <0x01>;
			#size-cells = <0x00>;
			status = "okay";
			clock-frequency = <400000>;  // Set I2C1 frequency to 400 kHz

			slb9673: slb9673@2e {
				compatible = "infineon,slb9673", "tcg,tpm-tis-i2c";
				reg = <0x2e>;
				status = "okay";
			};
		};
	};
};
